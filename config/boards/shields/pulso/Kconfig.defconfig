## config/boards/shields/pulso/Kconfig.defconfig
```kconfig
# Copyright (c) 2022 The ZMK Contributors
# SPDX-License-Identifier: MIT

if SHIELD_PULSO_LEFT

config ZMK_KEYBOARD_NAME
    default "PULSO"
    
config ZMK_SPLIT_ROLE_CENTRAL
    default y

endif

if SHIELD_PULSO_LEFT || SHIELD_PULSO_RIGHT

config ZMK_SPLIT
    default y

endif
```
